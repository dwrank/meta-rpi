## conf/distro/rpi.conf
```bitbake
require conf/distro/poky.conf

DISTRO_NAME = "drank (Custom RPi Distro)"
DISTRO_VERSION = "0.0.1"

MAINTAINER = "Daniel Rank <dwrank@gmail.com>"
```

## conf/layer.conf
```bitbake
# We have a conf and classes directory, add to BBPATH
BBPATH .= ":${LAYERDIR}"

# We have recipes-* directories, add to BBFILES
BBFILES += "${LAYERDIR}/recipes-*/*/*.bb \
            ${LAYERDIR}/recipes-*/*/*.bbappend \
            ${LAYERDIR}/images/*.bb"

BBFILE_COLLECTIONS += "meta-rpi"
BBFILE_PATTERN_meta-rpi = "^${LAYERDIR}/"
BBFILE_PRIORITY_meta-rpi = "6"

LAYERSERIES_COMPAT_meta-rpi = "sumo"
```
